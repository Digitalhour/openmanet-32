## main/Kconfig.projbuild
```kconfig
menu "hopnode"

    config HOP_MESH_ID
        string "Mesh name suggested on the setup page (empty: none)"
        default ""
        help
            Only a suggestion filled into the first-boot setup page. The mesh name and
            password are chosen there by the owner and kept in NVS; nothing about the
            network is built into the firmware.

    config HOP_S1G_CHANNEL
        int "HaLow channel (S1G channel number)"
        range 1 51
        default 26

    config HOP_S1G_OPCLASS
        int "HaLow operating class"
        range 68 71
        default 69

    config HOP_PRI_BW_MHZ
        int "Primary channel width in MHz (0 = default)"
        range 0 2
        default 0
        help
            Must match the Linux nodes: OpenMANET's s1g_prim_chwidth=1 means 2 MHz.

    config HOP_PRI_1MHZ_IDX
        int "Primary 1 MHz channel index inside the channel"
        range 0 7
        default 0
        help
            Must match the Linux nodes' s1g_prim_1mhz_chan_index.

    config HOP_BEACON_TUS
        int "Beacon interval in TU (0 = default)"
        range 0 10000
        default 0
        help
            OpenMANET uses 1000.

    config HOP_TX_DBM
        int "Cap HaLow TX power (dBm, 0 = regulatory maximum)"
        range 0 30
        default 8

    config HOP_BAT_SUBNET
        string "bat0 subnet (the node takes .<last byte of its bat address>)"
        default "10.41.250.0"

    config HOP_BAT_MASK
        string "bat0 netmask"
        default "255.255.0.0"

    config HOP_PING_PEERS
        bool "Ping every known bat0 node over the mesh every 5 s and log the result"
        default y

    config HOP_HALOW_SPI_MAX_HZ
        int "Cap the HaLow SPI clock (Hz)"
        range 1000000 50000000
        default 40000000

    config HOP_HALOW_RESET_HOLD_MS
        int "Hold the HaLow chip in reset this long (ms)"
        range 5 20000
        default 8000

    config HOP_HALOW_RESET_SETTLE_MS
        int "HaLow chip boot time after reset (ms)"
        range 20 2000
        default 250

    config HOP_AP_SSID
        string "Hotspot name (empty: Meshpoint- and the last MAC bytes)"
        default ""
        help
            The 2.4 GHz hotspot phones and laptops join to reach the mesh and the settings
            page. The page can change it; this is the value before anything is saved there.

    config HOP_AP_CHANNEL
        int "Hotspot 2.4 GHz channel"
        range 1 13
        default 6

    config HOP_AP_TX_DBM
        int "Hotspot transmit power cap (dBm)"
        range 2 20
        default 11
        help
            Kept low by default: the 2.4 GHz radio's current peaks add to the HaLow radio's
            on the same USB supply.

    config HOP_AP_IP
        string "Hotspot address (a /24; the settings page lives here)"
        default "192.168.4.1"

    config HOP_ROOT_DEFAULT_PASSWORD
        string "Default root password (signs in to setup only)"
        default "openmanet"
        help
            The hotspot page asks for user root and a password. Until setup is finished
            this default signs in; setup makes the owner choose a new one, which replaces
            it. Erasing the settings (BOOT held 5 s) brings the default back.

    config HOP_RESET_GPIO
        int "Button that erases the settings when held 5 s (-1: none)"
        range -1 48
        default 0
        help
            The XIAO ESP32S3's BOOT button is GPIO 0. Holding it for 5 seconds while the
            node runs erases the settings (root password included) and restarts into
            setup mode. (Held while
            powering on, it still enters the ROM download mode as usual.)

    config HOP_LED_GPIO
        int "LED that blinks while waiting for setup (-1: none)"
        range -1 48
        default 21
        help
            The XIAO ESP32S3's user LED is GPIO 21, lit when the pin is low.

endmenu
```
